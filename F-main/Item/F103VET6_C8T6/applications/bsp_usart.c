#include "bsp_usart.h"

u8 count = 0;//接受计数器
unsigned char USART_RX_BUF[USART_REC_LEN];     //接收缓冲,最大USART_REC_LEN个字节.
//接收状态
//bit15，	接收完成标志
//bit14，	接收到0x0d
//bit13~0，	接收到的有效字节数目
u8 ch=0;
u8 aRxBuffer[RXBUFFERSIZE];//HAL库使用的串口接收缓冲
unsigned char crc8;
// 按照多项式 X^8+X^2+X^1+1 生成。
static const unsigned int crc8Table[256] =
{
	0x00, 0x07, 0x0E, 0x09, 0x1C, 0x1B, 0x12, 0x15, 0x38, 0x3F, 0x36, 0x31, 0x24, 0x23, 0x2A, 0x2D,
	0x70, 0x77, 0x7E, 0x79, 0x6C, 0x6B, 0x62, 0x65, 0x48, 0x4F, 0x46, 0x41, 0x54, 0x53, 0x5A, 0x5D,
	0xE0, 0xE7, 0xEE, 0xE9, 0xFC, 0xFB, 0xF2, 0xF5, 0xD8, 0xDF, 0xD6, 0xD1, 0xC4, 0xC3, 0xCA, 0xCD,
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	0xDE, 0xD9, 0xD0, 0xD7, 0xC2, 0xC5, 0xCC, 0xCB, 0xE6, 0xE1, 0xE8, 0xEF, 0xFA, 0xFD, 0xF4, 0xF3
};
// 计算CRC
unsigned char calcCRC(unsigned char *data, unsigned int len)
{
	unsigned char crc8 = 0;

    while (len --)
    {
        crc8 = crc8 ^ (*data++);
        crc8 = crc8Table[crc8];
    }

    return crc8;
}


void HAL_UART_RxCpltCallback(UART_HandleTypeDef *huart)
{
	if(huart->Instance == USART1)
	{
		
		ch= aRxBuffer[0];
		
//		USART_RX_BUF[count] = aRxBuffer[0];
//		count++;
		HAL_UART_Receive_IT(&huart1, (u8 *)aRxBuffer, RXBUFFERSIZE);
//		if(count==4)
//		{
//			if((USART_RX_BUF[0]==0x0A)&&(USART_RX_BUF[3]==0x0F))
//			{
//				crc8 = calcCRC(USART_RX_BUF, 2);
//				if(USART_RX_BUF[2]==crc8)
//				{
//					ch=USART_RX_BUF[1];
//				}
//				count=0;
//			}
//		}
	}
}

/*****************  发送字符串 **********************/
void Usart_SendString(uint8_t *str)
{
	unsigned int k=0;
  do 
  {
      HAL_UART_Transmit(&huart1,(uint8_t *)(str + k) ,1,1000);
      k++;
  } while(*(str + k)!='\0');
  
}
///重定向c库函数printf到串口DEBUG_USART，重定向后可使用printf函数
int fputc(int ch, FILE *f)
{
	/* 发送一个字节数据到串口DEBUG_USART */
	HAL_UART_Transmit(&huart1, (uint8_t *)&ch, 1, 1000);	
	
	return (ch);
}

///重定向c库函数scanf到串口DEBUG_USART，重写向后可使用scanf、getchar等函数
int fgetc(FILE *f)
{
		
	int ch;
  while (__HAL_UART_GET_FLAG(&huart1, UART_FLAG_RXNE) == RESET);
	HAL_UART_Receive(&huart1, (uint8_t *)&ch, 1, 1000);	
  
	return (ch);
}


void ShowMessage(void)
{
	printf("\r\n   这是一个通过串口通信指令控制电机的实验 \n");
	printf("开发板接到指令后控制电机转动，指令对应如下：  \n");
  printf("   指令   ------              机构动作        \n");
  printf("     1    ------  主线抱紧机构夹紧(电机转5圈) \n");
  printf("     2    ------  主线抱紧机构松开(电机松5圈) \n");
	printf("     3    ------  刀具提升(电机转5圈)         \n");
  printf("     4    ------  刀具下降(电机松5圈)         \n");
	printf("     5    ------  旋转切皮(速度为1500)        \n");
  printf("     6    ------  停止旋转(速度为0)           \n");
	printf("     0    ------  所有机构初始化              \n");
}
